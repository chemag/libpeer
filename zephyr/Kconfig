## zephyr/Kconfig
```kconfig
menu "libpeer"

config LIBPEER
	bool "Enable libpeer module"
	default n
	help
	  Enable libpeer integration for Zephyr builds.

if LIBPEER

config LIBPEER_SIGNALING
	bool "Built-in HTTP and MQTT signaling"
	default y
	help
	  Build peer_signaling.c with coreHTTP and coreMQTT. It links the cjson
	  library, which a cJSON module must provide. Disable it when the
	  application exchanges the session descriptions itself.

config LIBPEER_BUNDLED_LIBSRTP
	bool "Build libsrtp from the third_party/libsrtp submodule"
	default y
	help
	  Build the libsrtp sources libpeer uses from its submodule. Disable it
	  to link against the srtp library of a separate libsrtp module.

config LIBPEER_DTLS_ECDSA
	bool "Use an ECDSA certificate for DTLS"
	help
	  Generate an ECDSA DTLS certificate instead of an RSA one.

config LIBPEER_STRICT_CHROME_PROFILE
	bool "Constrained Chrome media profile"
	help
	  Build with CONFIG_STRICT_CHROME_PROFILE, the constrained PCMU and
	  H.264 profile described in src/config.h.

config LIBPEER_RTCP_SENDER_REPORTS
	bool "Send RTCP sender reports"
	default y
	help
	  Send an RTCP sender report every second for each stream the
	  application sends with peer_connection_send_audio_ts() or
	  peer_connection_send_video_ts(), provided it sets the clock_us
	  callback of the PeerConfiguration. The remote peer needs the
	  reports to play the audio and the video in sync. Without the
	  option the reception reports are still sent, in receiver reports.

config LIBPEER_LOG_LEVEL
	int "libpeer log level"
	range 0 3
	default 2
	help
	  0 for errors, 1 for warnings, 2 for information and 3 for debug
	  messages.

config LIBPEER_LOG_REDIRECT
	bool "Send libpeer log messages to peer_log()"
	help
	  Pass libpeer log messages to a peer_log() function provided by the
	  application instead of printing them to stdout.

endif # LIBPEER

endmenu
```
